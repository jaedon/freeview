## device/product_config/defconfigs/kconfigs/Kconfig
```kconfig
# Platform configuration

menu "Platform Configuration"

config PRODUCT_NAME
	string
	prompt "Require product name for building each customized compile options"
	default "base7356"

config BOARD_REVISION
	string
	prompt "Require board revision number"
	default "rev0.1"

config PRODUCT_APP_NAME
	string
	prompt "Require application name"
	default "octo"

	choice 
		prompt "MIPS/ARM"
		default MIPS	

	config ARM
		bool "ARM ARCH"	

	config MIPS
		bool "MIPS ARCH"	

	endchoice

endmenu

menu "Select S/W image mode "
choice
	prompt "Debug/release"
	default PRODUCT_IMAGE_DEBUG

	config PRODUCT_IMAGE_DEBUG
		bool "Debug"
	
	config PRODUCT_IMAGE_RELEASE
		bool "Release"

endchoice
endmenu

menu "Select application image type "
choice
	prompt "Application type"
	default PRODUCT_IMAGE_HWTEST

	config PRODUCT_IMAGE_HWTEST
		bool "H/W test S/W"

	config PRODUCT_IMAGE_UOCTO
		bool "uOCTO for OTA S/W"
		select INITRAMFS_LINUX if PRODUCT_IMAGE_RELEASE

	config PRODUCT_IMAGE_UPGRADER
		bool "UPGRADER S/W"
		select INITRAMFS_LINUX if PRODUCT_IMAGE_RELEASE

	config PRODUCT_IMAGE_FACTORY
		bool "Factory S/W"
		select INITRAMFS_LINUX if PRODUCT_IMAGE_RELEASE

	config PRODUCT_IMAGE_DIAGNOSTIC
		bool "Diagnostic S/W"

	config PRODUCT_IMAGE_OCTO
		bool "OCTO S/W"

	config PRODUCT_IMAGE_OCTO20
		bool "OCTO 2.0 S/W"

	config PRODUCT_IMAGE_NOAPP
		bool "No Application S/W"

endchoice
endmenu

menu "Select process type "
choice
	prompt "Single/multi-process"
	default PRODUCT_SINGLE_PROCESS

	config PRODUCT_SINGLE_PROCESS
		bool "Single"
	
	config PRODUCT_MULTI_PROCESS
		bool "Multi"
endchoice
endmenu


menu  "Select file-system"
config TARGET_ROOTFS_SQUASHFS
	depends on PRODUCT_IMAGE_RELEASE || PRODUCT_IMAGE_DEVELOP_RELEASE
	bool "squashfs" 
	default y if PRODUCT_IMAGE_HWTEST || PRODUCT_IMAGE_OCTO || PRODUCT_IMAGE_OCTO20
	help
		Build a squashfs-lzma root filesystem At normal release mode

config INITRAMFS_LINUX
	depends on PRODUCT_IMAGE_FACTORY || PRODUCT_IMAGE_UOCTO || PRODUCT_IMAGE_UPGRADER
	bool "initram"
	prompt "Initramfs linux system"
	default y if PRODUCT_IMAGE_RELEASE
	help
		Buile a inintramfs linux filesystem At Factory mode
endmenu
	
menu "Enable debug log"
config PRODUCT_KERNEL_DEBUG_LOG
	bool
	prompt "Kernel log"
	default y if PRODUCT_IMAGE_DEBUG || PRODUCT_IMAGE_HWTEST || DEVELOP 

config PRODUCT_ROOTFS_DEBUG_LOG
	bool
	prompt "Rootfs log"
	default y if PRODUCT_IMAGE_DEBUG || PRODUCT_IMAGE_HWTEST || PRODUCT_IMAGE_FACTORY

config PRODUCT_DEVICE_DEBUG_LOG
	bool
	prompt "Device log"
	default y if PRODUCT_IMAGE_DEBUG || PRODUCT_IMAGE_HWTEST

config PRODUCT_DI_DEBUG_LOG
	bool
	prompt "Driver log"
	default y if PRODUCT_IMAGE_DEBUG || PRODUCT_IMAGE_HWTEST || PRODUCT_IMAGE_FACTORY || DEVELOP

config PRODUCT_APP_DEBUG_LOG
	bool
	prompt "Application log"
	default y if PRODUCT_IMAGE_DEBUG || PRODUCT_IMAGE_HWTEST
endmenu

config HAVE_DOT_CONFIG
	bool
	default y

menu "Enable features"
config AUTO_BUILD_IMAGE
	depends on PRODUCT_IMAGE_RELEASE
	bool "Auto Build Image"
	default n

config DEVELOP
	depends on PRODUCT_IMAGE_RELEASE
	bool "Develop Release Image"
	default n
endmenu
```

## device/product_config/defconfigs/kconfigs/Kconfig.bcm
```kconfig
menu "Broadcom Configuration"

config PLATFORM
	string
	prompt "Platform number"
	default 97335

config CHIP
	string
	prompt "Chip number"
	default 7335

config CHIP_REV
	string
	prompt "Chip revision number"
	default B0

choice
	prompt "Platform endian"
	default ENDIAN_LITTLE

menuconfig ENDIAN_BIG
	bool "big-endian"	

menuconfig ENDIAN_LITTLE
	bool "little-endian"	

endchoice

choice
	prompt "Platform OS"
	default OS_LINUX

menuconfig OS_LINUX
	bool "Linux"

menuconfig OS_UCOS
	bool "uCos"

endchoice

config TOOLCHAIN_PATH
	string
	prompt "Toolchain path"
	default "/opt/toolchains/crosstools_hf-linux-2.6.18.0_gcc-4.2-11ts_uclibc-nptl-0.9.29-20070423_20090508"

config KERNEL_TOOLCHAIN_PATH
	string
	prompt "Kernel Toolchain path"
	default n

config TOOLCHAIN_PATCH
	bool
	prompt "Toolchain patch"
	default n

config TOOLCHAIN_PATCH_DIR
	string
	prompt "Toolchain patch directory"
	default "platform/sdk/toolchains/patch/stbgcc-4.5.3-1.3/uclibc-0.9.32a/le"
	depends on TOOLCHAIN_PATCH

endmenu

config BCM_DOT_CONFIG
	bool
	default y

source "Kconfig.kernel"
source "Kconfig.rootfs"
source "Kconfig.device"
source "driver/bcm_kconfig"

menu "Advanced configuration options (for developers)"
config DEVEL
	bool
	default y
	select BUILDOPTS

config BROKEN
	bool "Show broken platforms /packages" if DEVEL

menuconfig BUILDOPTS
	bool "Build Options" if DEVEL

config CCACHE
	bool
	prompt "Use ccache" if BUILDOPTS
	default n
	help
		Compiler cache; see http://ccache.samba.org/

config JLEVEL
	int
	prompt "Number of jobs to run simultaneously" if BUILDOPTS
	default "2"
	help
		Number of jobs to run simultaneously

config USES_TFTPBOOT
	bool
	prompt "Use tftpboot" if DEVEL
	default y

config PRODUCT_TFTPBOOT_DIR
	string
	prompt "tftpboot dir"
	default "/tftpboot"

config USES_NFSROOT
	bool
	prompt "Use nfsroot" if DEVEL
	default y

config PRODUCT_NFSROOT_DIR
	string
	prompt "nfsroot dir"
	default "/nfsroot"
	
config AUTO_STRIP
	bool
	prompt "Striping en bloc targets before making squashfs"
	help
		Strip targets : KO drivers, Shared lib, User apps
	default y
	
config I2C_ASYNC
	bool
	prompt "I2C_ASYNC"
	default n
		
menu "Use TAR build"

config TAR_BUILD_KERNEL
	bool
	prompt "Unpack kernel and patch"

config TAR_BUILD_URSR
	bool
	prompt "Unpack URSR and patch"

endmenu

endmenu
```
